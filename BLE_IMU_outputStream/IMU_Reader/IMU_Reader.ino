/*
 * Generated by Claude Code
 * --------------
 * Streams gyroscope X/Y data over USB Serial
 * Arduino Nano 33 BLE Sense.
 *
 */

#include <Arduino_LSM9DS1.h>

// Built-in LED used to signal ready state
#define READY_LED LED_BUILTIN

void setup() {
  pinMode(READY_LED, OUTPUT);
  digitalWrite(READY_LED, LOW);

  // High baud rate — minimize serial transmission time
  Serial.begin(500000);

  // Wait for serial port to connect (important for native USB boards)
  while (!Serial);

  // Initialize IMU
  if (!IMU.begin()) {
    // Flash rapidly to signal IMU init failure
    while (true) {
      digitalWrite(READY_LED, HIGH); delay(100);
      digitalWrite(READY_LED, LOW);  delay(100);
    }
  }

  // Signal ready — LED on solid
  digitalWrite(READY_LED, HIGH);

  // Optional: print sample rate once so the reader knows what to expect
  // Comment out if you want pure data lines only
  Serial.print("# gyro_sample_rate=");
  Serial.print(IMU.gyroscopeSampleRate());
  Serial.println("Hz");
}

void loop() {
  float x, y, z;

  // Only read when a new sample is ready — avoids blocking and duplicate reads
  if (IMU.gyroscopeAvailable()) {
    IMU.readGyroscope(x, y, z);

    // Send X,Y only — Z (twist) not needed for 2D canvas
    // Use print + println to avoid String object overhead
    Serial.print(x, 2);   // 2 decimal places is plenty
    Serial.print(',');
    Serial.println(y, 2);
  }

  // No delay — let the IMU's own sample rate gate the output
  // The LSM9DS1 runs at 119 Hz by default, so loop naturally throttles
}
